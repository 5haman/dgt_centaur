## buildroot/configs/centaur_defconfig
```kconfig
BR2_ROOTFS_OVERLAY="$(BR2_EXTERNAL_CENTAUR_PATH)/board/dgt/centaur/rootfs_overlay"
BR2_ROOTFS_POST_IMAGE_SCRIPT="$(BR2_EXTERNAL_CENTAUR_PATH)/board/dgt/centaur/post-image.sh"
BR2_ROOTFS_POST_BUILD_SCRIPT="$(BR2_EXTERNAL_CENTAUR_PATH)/board/dgt/centaur/post-build.sh"

BR2_CCACHE_DIR="$(HOME)/.ccache"
BR2_CCACHE=y
BR2_CCACHE_USE_BASEDIR=y

BR2_arm=y
BR2_arm1176jzf_s=y
BR2_ARM_EABIHF=y
BR2_OPTIMIZE_3=y

BR2_PACKAGE_HOST_LINUX_HEADERS_CUSTOM_5_10=y
BR2_PACKAGE_RPI_FIRMWARE=y
BR2_PACKAGE_HOST_DOSFSTOOLS=y
BR2_PACKAGE_HOST_GENIMAGE=y
BR2_PACKAGE_HOST_MTOOLS=y

BR2_TOOLCHAIN_BUILDROOT_CXX=y
# BR2_TOOLCHAIN_BUILDROOT_MUSL=y
BR2_TOOLCHAIN_BUILDROOT_GLIBC=y

BR2_LINUX_KERNEL=y
BR2_LINUX_KERNEL_DEFCONFIG="bcmrpi"
BR2_LINUX_KERNEL_CUSTOM_TARBALL=y
BR2_LINUX_KERNEL_CUSTOM_TARBALL_LOCATION="$(call github,raspberrypi,linux,4afd064509b23882268922824edc5b391a1ea55d)/linux-4afd064509b23882268922824edc5b391a1ea55d.tar.gz"
BR2_LINUX_KERNEL_DTS_SUPPORT=y
BR2_LINUX_KERNEL_INTREE_DTS_NAME="bcm2708-rpi-zero-w"
BR2_LINUX_KERNEL_NEEDS_HOST_OPENSSL=y

# Filesystem / image
BR2_TARGET_ROOTFS_EXT2=y
BR2_TARGET_ROOTFS_EXT2_4=y
BR2_TARGET_ROOTFS_EXT2_SIZE="150M"

BR2_TARGET_GENERIC_ROOT_PASSWD="centaur"
BR2_TARGET_GENERIC_HOSTNAME="centaur"
BR2_TARGET_GENERIC_ISSUE="Welcome to DGT Centaur"

BR2_PACKAGE_CRDA=y
BR2_PACKAGE_STRACE=y
BR2_PACKAGE_RNG_TOOLS=y
BR2_PACKAGE_DROPBEAR=y
BR2_PACKAGE_WPA_SUPPLICANT=y
BR2_PACKAGE_WPA_SUPPLICANT_CLI=y
BR2_PACKAGE_WPA_SUPPLICANT_WPA_CLIENT_SO=y
BR2_PACKAGE_WPA_SUPPLICANT_DEBUG_SYSLOG=y
BR2_PACKAGE_GIT=y
BR2_PACKAGE_HTOP=y
BR2_PACKAGE_PYTHON3=y
```

## buildroot/configs/zerow_defconfig
```kconfig
BR2_CCACHE=y
BR2_OPTIMIZE_3=y
BR2_TOOLCHAIN_BUILDROOT_MUSL=y
BR2_TARGET_GENERIC_HOSTNAME="centaur"
BR2_TARGET_GENERIC_ISSUE="Welcome to DGT Centaur!"
BR2_TARGET_ENABLE_ROOT_LOGIN=y
BR2_ROOTFS_OVERLAY="board/raspberrypi/zerow/rootfs_overlay/"
BR2_PACKAGE_STRACE=y
BR2_PACKAGE_RNG_TOOLS=y
BR2_PACKAGE_DHCPCD=y
BR2_PACKAGE_DROPBEAR=y
BR2_PACKAGE_WPA_SUPPLICANT=y
BR2_PACKAGE_WPA_SUPPLICANT_CLI=y
BR2_PACKAGE_WPA_SUPPLICANT_WPA_CLIENT_SO=y
BR2_PACKAGE_HOST_MKPASSWD=y
```
